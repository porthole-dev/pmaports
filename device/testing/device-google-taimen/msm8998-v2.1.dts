/* Copyright (c) 2018 Google, Inc.
 *
 * This software is licensed under the terms of the GNU General Public
 * License version 2, as published by the Free Software Foundation, and
 * may be copied, distributed, and modified under those terms.
 *
 * This program is distributed in the hope that it will be useful,
 * but WITHOUT ANY WARRANTY; without even the implied warranty of
 * MERCHANTABILITY or FITNESS FOR A PARTICULAR PURPOSE.  See the
 * GNU General Public License for more details.
 *
 */

/dts-v1/;

/ {
    #address-cells = <0x02>;
	#size-cells = <0x02>;
	model = "Google Inc. Qualcomm Technologies, Inc. MSM8998 v2.1";
    compatible = "qcom,msm8998-mtp", "qcom,msm8998", "qcom,mtp";
	qcom,msm-id = <0x124 0x20001>;
    //qcom,board-id = <1 0>;
};
